## board/licheepi_nano/licheepi_nano_mmc_defconfig
```kconfig
CONFIG_ARM=y
CONFIG_ARCH_SUNXI=y
CONFIG_SPL=y
CONFIG_MACH_SUNIV=y
CONFIG_DRAM_CLK=156
CONFIG_DRAM_ZQ=0

CONFIG_SYS_TEXT_BASE=0x81700000

CONFIG_DEFAULT_DEVICE_TREE="suniv-f1c100s-licheepi-nano"

CONFIG_USE_BOOTARGS=y
CONFIG_BOOTARGS="console=tty0 console=ttyS0,115200 panic=5 rootwait root=/dev/mmcblk0p2 rw rootfstype=ext4"

CONFIG_USE_BOOTCOMMAND=y
CONFIG_BOOTCOMMAND="load mmc 0:1 0x80C00000 suniv-f1c100s-licheepi-nano-custom.dtb; load mmc 0:1 0x80008000 zImage; bootz 0x80008000 - 0x80C00000"

# CONFIG_VIDEO_SUNXI is not set
CONFIG_SPL_SPI_SUNXI=y
CONFIG_SPI_FLASH_WINBOND=y
CONFIG_SPI_FLASH_XTX=y
CONFIG_SPI=y
```

## board/licheepi_nano/licheepi_nano_spiflash_defconfig
```kconfig
CONFIG_ARM=y
CONFIG_ARCH_SUNXI=y
CONFIG_SPL=y
CONFIG_MACH_SUNIV=y
CONFIG_DRAM_CLK=156
CONFIG_DRAM_ZQ=0

CONFIG_SYS_TEXT_BASE=0x81700000

CONFIG_DEFAULT_DEVICE_TREE="suniv-f1c100s-licheepi-nano"
CONFIG_DEVICE_TREE_INCLUDES="suniv-f1c100s-licheepi-nano-spiflash.dtsi"

CONFIG_USE_BOOTARGS=y
CONFIG_BOOTARGS="console=tty0 console=ttyS0,115200 panic=5 rootwait root=/dev/mtdblock3 rw rootfstype=jffs2"

CONFIG_USE_BOOTCOMMAND=y
CONFIG_BOOTCOMMAND="sf probe; sf read 0x80C00000 0x100000 0x4000; sf read 0x80008000 0x110000 0x4F0000; bootz 0x80008000 - 0x80C00000"

CONFIG_SPI_BOOT=y

CONFIG_CMD_LSBLK=y
CONFIG_CMD_JFFS2=y
CONFIG_CMD_SF=y
CONFIG_CMD_SPI=y

CONFIG_FS_JFFS2=y
CONFIG_JFFS2_DEV="nor0"
CONFIG_JFFS2_PART_OFFSET=0x0
CONFIG_JFFS2_PART_SIZE=0xFFFFFFFF
CONFIG_JFFS2_LZO=y
CONFIG_JFFS2_NAND=y

# CONFIG_VIDEO_SUNXI is not set
CONFIG_SPL_SPI_SUNXI=y
CONFIG_SPI_FLASH_XTX=y
CONFIG_SPI=y
# CONFIG_CMD_FLASH is not set
# CONFIG_CMD_FPGA is not set
CONFIG_ENV_SIZE=0x8000
CONFIG_ENV_OFFSET=0xf8000

CONFIG_ENV_IS_IN_SPI_FLASH=y
CONFIG_SPI_FLASH_BAR=y
CONFIG_SPI_FLASH_GIGADEVICE=y
CONFIG_SPI_FLASH_MACRONIX=y

# CONFIG_SPL_DM_SERIAL is not set
CONFIG_DM_SPI=y
CONFIG_SUN6I_SPI=y
CONFIG_SPI_MEM=y

CONFIG_MTD=y
CONFIG_DM_MTD=y
CONFIG_DM_SPI_FLASH=y
CONFIG_SPI_FLASH=y
CONFIG_BOOTDEV_SPI_FLASH=y
CONFIG_SPI_FLASH_WINBOND=y
CONFIG_SPI_FLASH_USE_4K_SECTORS=y
CONFIG_SPI_FLASH_MTD=y
```

## configs/licheepi_nano_spiflash_defconfig
```kconfig
#
# Main Buildroot config file for LicheePi Nano
#

#
# ARMv5 compilation target
#
BR2_arm=y
BR2_ARCH="arm"
BR2_ENDIAN="LITTLE"
BR2_GCC_TARGET_ABI="aapcs-linux"
BR2_GCC_TARGET_CPU="arm926ej-s"
BR2_GCC_TARGET_FLOAT_ABI="soft"
BR2_GCC_TARGET_MODE="arm"
BR2_ARM_CPU_MAYBE_HAS_FPU=y
BR2_ARM_CPU_MAYBE_HAS_VFPV2=y
BR2_ARM_CPU_HAS_ARM=y
BR2_ARM_CPU_HAS_THUMB=y
BR2_ARM_CPU_ARMV5=y
BR2_arm926t=y

#
# Debug messages for BR2 downloads
#
BR2_ENABLE_DEBUG=y

#
# Buildroot toolchain defined as external tarball
#
BR2_TOOLCHAIN_BUILDROOT=n
BR2_TOOLCHAIN_EXTERNAL=y
BR2_TOOLCHAIN_EXTERNAL_CUSTOM=y
BR2_TOOLCHAIN_EXTERNAL_DOWNLOAD=y
BR2_TOOLCHAIN_EXTERNAL_URL="file:///root/arm-buildroot-linux-gnueabi_sdk-buildroot.tar.gz"
BR2_TOOLCHAIN_EXTERNAL_GCC_11=y
BR2_TOOLCHAIN_EXTERNAL_HEADERS_5_11=y
BR2_TOOLCHAIN_EXTERNAL_CUSTOM_GLIBC=y
BR2_TOOLCHAIN_EXTERNAL_CXX=y
BR2_TOOLCHAIN_EXTERNAL_INET_RPC=n
BR2_TOOLCHAIN_EXTERNAL_WCHAR=y
BR2_TOOLCHAIN_EXTERNAL_LOCALE=y
BR2_TOOLCHAIN_EXTERNAL_HAS_SSP=y

#
# OS name and login settings
#
BR2_TARGET_GENERIC_HOSTNAME="licheepi-nano"
BR2_TARGET_GENERIC_ISSUE="Welcome to LicheePi Nano"
BR2_TARGET_GENERIC_ROOT_PASSWD="root"
BR2_TARGET_GENERIC_GETTY_PORT="/dev/ttyS0"
BR2_TARGET_GENERIC_GETTY_BAUDRATE_115200=y

#
# Custom file additions
#
BR2_ROOTFS_OVERLAY="$(BR2_EXTERNAL_LICHEEPI_NANO_PATH)/board/licheepi_nano/rootfs-overlay"

#
# Linux kernel customized for the board
# (using tarball download as it is much faster than Git)
#
BR2_LINUX_KERNEL=y
BR2_LINUX_KERNEL_CUSTOM_TARBALL=y
# BR2_LINUX_KERNEL_CUSTOM_GIT=y

# @unframework Linux fork and tag
# (cherry-picked from Lichee-Pi Linux fork nano-5.2-flash branch as of 2021-03-06)
BR2_LINUX_KERNEL_CUSTOM_TARBALL_LOCATION="https://github.com/unframework/linux/archive/v5.11-nano-4/v5.11-nano-4.tar.gz"
BR2_LINUX_KERNEL_VERSION="v5.11-nano-4"

# original Lichee-Pi Linux fork and branch without Flash-specific config changes
# BR2_LINUX_KERNEL_CUSTOM_REPO_URL="https://github.com/Lichee-Pi/linux"
# BR2_LINUX_KERNEL_CUSTOM_REPO_VERSION="nano-5.2-tf"

BR2_LINUX_KERNEL_USE_CUSTOM_CONFIG=y
BR2_LINUX_KERNEL_CUSTOM_CONFIG_FILE="$(BR2_EXTERNAL_LICHEEPI_NANO_PATH)/board/licheepi_nano/licheepi_nano_linux_defconfig"

# original Lichee-Pi Linux fork provided defconfig
# BR2_LINUX_KERNEL_DEFCONFIG="licheepi_nano"

# custom DTS file with local overrides
BR2_LINUX_KERNEL_DTS_SUPPORT=y
BR2_LINUX_KERNEL_CUSTOM_DTS_PATH="$(BR2_EXTERNAL_LICHEEPI_NANO_PATH)/board/licheepi_nano/suniv-f1c100s-licheepi-nano-spiflash.dts"
# BR2_LINUX_KERNEL

#
# Build root FS jffs2 (for SPI flash)
#
BR2_TARGET_ROOTFS_JFFS2=y
BR2_TARGET_ROOTFS_JFFS2_CUSTOM=y
BR2_TARGET_ROOTFS_JFFS2_CUSTOM_EBSIZE=0x10000
BR2_TARGET_ROOTFS_JFFS2_PAD=y

# BR2_TARGET_ROOTFS_TAR is not set

#
# Package up the images for deployment to board
#
BR2_ROOTFS_POST_IMAGE_SCRIPT="$(BR2_EXTERNAL_LICHEEPI_NANO_PATH)/board/licheepi_nano/post-image.sh"
BR2_ROOTFS_POST_SCRIPT_ARGS="genimage.cfg"

#
# U-Boot customized for the board
#
BR2_TARGET_UBOOT=y
BR2_TARGET_UBOOT_BUILD_SYSTEM_KCONFIG=y
BR2_TARGET_UBOOT_BOARDNAME="licheepi_nano_spiflash"
BR2_TARGET_UBOOT_BOARD_DEFCONFIG="licheepi_nano_spiflash_defconfig"
BR2_TARGET_UBOOT_CUSTOM_TARBALL=y
BR2_TARGET_UBOOT_CUSTOM_TARBALL_LOCATION="https://github.com/padiazg/licheepi-nano-u-boot/archive/2024.10-licheepi-nano/2024.10-licheepi-nano.tar.gz"
BR2_TARGET_UBOOT_VERSION="custom"
# BR2_TARGET_UBOOT_CUSTOM_GIT=y
# BR2_TARGET_UBOOT_CUSTOM_REPO_URL="https://github.com/padiazg/licheepi-nano-u-boot.git"
# BR2_TARGET_UBOOT_CUSTOM_REPO_VERSION="2024.10-licheepi-nano"
BR2_TARGET_UBOOT_PATCH=""
BR2_TARGET_UBOOT_USE_DEFCONFIG=y
BR2_TARGET_UBOOT_BOARD_DEFCONFIG="licheepi_nano_spiflash"
BR2_TARGET_UBOOT_CONFIG_FRAGMENT_FILES=""
BR2_TARGET_UBOOT_NEEDS_DTC=y
BR2_TARGET_UBOOT_NEEDS_PYTHON3=y
BR2_TARGET_UBOOT_NEEDS_PYLIBFDT=y

#
# U-Boot binary format
#
BR2_TARGET_UBOOT_FORMAT_BIN=y
BR2_TARGET_UBOOT_FORMAT_DTB=y
BR2_TARGET_UBOOT_FORMAT_ELF=y
BR2_TARGET_UBOOT_FORMAT_IMG=y
BR2_TARGET_UBOOT_FORMAT_DTB_IMG=y
BR2_TARGET_UBOOT_FORMAT_CUSTOM=y
BR2_TARGET_UBOOT_FORMAT_CUSTOM_NAME="u-boot-sunxi-with-spl.bin"
BR2_TARGET_UBOOT_CUSTOM_DTS_PATH=""
BR2_TARGET_UBOOT_CUSTOM_MAKEOPTS=""

# BR2_PACKAGE_HOST_UBOOT_TOOLS_BOOT_SCRIPT=y
# BR2_PACKAGE_HOST_UBOOT_TOOLS_BOOT_SCRIPT_SOURCE="$(BR2_EXTERNAL_LICHEEPI_NANO_PATH)/board/licheepi_nano/boot_mmc.cmd"

#
# Target packages
#
BR2_PACKAGE_HOST_DOSFSTOOLS=y
BR2_PACKAGE_HOST_DTC=y
BR2_PACKAGE_HOST_E2FSPROGS=y
BR2_PACKAGE_HOST_GENIMAGE=y
BR2_PACKAGE_HOST_MTD=y
BR2_PACKAGE_HOST_MTOOLS=y
BR2_PACKAGE_HOST_SUNXI_TOOLS=y
BR2_PACKAGE_HOST_UBOOT_TOOLS=y
BR2_PACKAGE_HOST_UTIL_LINUX=y

#
# Preload Linux firmware source repo for dev
#
BR2_PACKAGE_LINUX_FIRMWARE=y

# esp8089 support
BR2_PACKAGE_IW=y
BR2_PACKAGE_WIRELESS_REGDB=y
BR2_PACKAGE_WIRELESS_TOOLS=y
BR2_PACKAGE_WPA_SUPPLICANT=y
BR2_PACKAGE_ESP8089=y

#
# ZSH
#
# BR2_PACKAGE_BUSYBOX_SHOW_OTHERS=y
# BR2_SYSTEM_BIN_SH_ZSH=y
# BR2_SYSTEM_BIN_SH="zsh"
# BR2_PACKAGE_NCURSES=y
# BR2_PACKAGE_ZSH=y
```

## package/esp8089/Config.in
```kconfig
config BR2_PACKAGE_ESP8089
	bool "esp8089"
	depends on BR2_LINUX_KERNEL
	help
		ESP8089 WiFi driver for Allwinner H3
		https://github.com/Icenowy/esp8089
```
